## src/audio/hifi_intrin_test/Kconfig
```kconfig
# SPDX-License-Identifier: BSD-3-Clause

config COMP_HIFI_INTRIN_TEST
	tristate "HiFi intrinsic test module (LLEXT)"
	default n
	depends on IPC_MAJOR_4 && LLEXT
	help
	  Build a standalone HiFi intrinsic test module as an LLEXT.
	  When loaded on HiFi3/HiFi4 targets (e.g. intel_ace15_adsp) it
	  runs a suite of HiFi intrinsic tests via printk and reports
	  the number of failures.  Useful for QEMU and hardware bring-up.
```

## src/audio/rust_template/Kconfig
```kconfig
# SPDX-License-Identifier: BSD-3-Clause

config COMP_RUST_TEMPLATE
	tristate "Rust template example component (llext)"
	default n
	depends on LLEXT
	help
	  Build a minimal SOF processing module whose entire module_interface
	  vtable is implemented in Rust via the sof_module crate. Selecting =m
	  builds it as a dynamically loadable llext for Xtensa targets.

	  Requires a Rust toolchain capable of cross-compiling to
	  xtensa-intel_ace30_ptl-zephyr-elf (see sof/doc/rust.md).
```

## test/ztest/unit/rust_hello/testcase.yaml
```yaml
# SPDX-License-Identifier: BSD-3-Clause
tests:
  sof.unit.rust_hello:
    platform_allow:
      - native_sim/native/64
    harness: ztest
    tags: unit rust
```

## test/ztest/unit/rust_module_iface/testcase.yaml
```yaml
# SPDX-License-Identifier: BSD-3-Clause
tests:
  sof.unit.rust_module_iface:
    platform_allow:
      - native_sim/native/64
    harness: ztest
    tags: unit rust
```
