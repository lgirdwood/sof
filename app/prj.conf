## CMakeLists.txt
```
# SPDX-License-Identifier: Apache-2.0

cmake_minimum_required(VERSION 3.21.0)

find_package(Zephyr HINTS $ENV{ZEPHYR_BASE})
project(sample_sof)

# -mllvm is a Clang/LLVM-only flag, guard against gcc
if(CMAKE_C_COMPILER_ID STREQUAL "Clang" OR CMAKE_CXX_COMPILER_ID STREQUAL "Clang")
  zephyr_compile_options(-mllvm --text-section-literals=false)
endif()


target_sources(app PRIVATE
    src/main.c
  )

zephyr_library_include_directories(app PUBLIC
    ${CMAKE_CURRENT_SOURCE_DIR}/../src/arch/xtensa/include
    ${CMAKE_CURRENT_SOURCE_DIR}/../src/include
  )
```

## prj.conf
```kconfig
CONFIG_BUILD_OUTPUT_BIN=n

# The additional stripped .elf files are deterministic.
# This adds very few files in the build directory and has
# absolutely no other effect whatsoever.
# See on-going discussion in
# https://github.com/zephyrproject-rtos/zephyr/pull/51954
# and usage in xtensa-build-zephyr.py
CONFIG_BUILD_OUTPUT_STRIPPED=y

CONFIG_HAVE_AGENT=n

# Since Zephyr commit f0daf904bb0202c PICOLIBC is the new default.
# We need more time to test and evaluate.
CONFIG_MINIMAL_LIBC=y

CONFIG_ZEPHYR_LOG=y
CONFIG_TRACE=n
CONFIG_LOG=y
CONFIG_LOG_PRINTK=y
# Log processing is offloaded to a low-priority thread.
CONFIG_LOG_MODE_DEFERRED=y
# Wake the low-priority log thread every time new log
# messages are available
CONFIG_LOG_PROCESS_TRIGGER_THRESHOLD=1
# Log processing thread maximum sleep between batches.
# Matches the periodic flush interval in log_backend_probe.c so that
# messages queued while the trigger threshold is not met are still
# drained within 500ms.
CONFIG_LOG_PROCESS_THREAD_SLEEP_MS=500
# Frontend buffer must be large enough to cover all
# typical bursts of log messages.
CONFIG_LOG_BUFFER_SIZE=4096
# Use stack that is sufficient for SOF backends
CONFIG_LOG_PROCESS_THREAD_STACK_SIZE=4096
# Use Linux kernel style timestamp format
CONFIG_LOG_OUTPUT_FORMAT_LINUX_TIMESTAMP=y

# Requires heap_info() be implemented, but no Zephyr wrapper
CONFIG_DEBUG_MEMORY_USAGE_SCAN=n

# Ensure -O2 (or similar) is used for optimization
CONFIG_SPEED_OPTIMIZATIONS=y

# Zephyr top-level default of -fno-strict-overflow is
# not a good fit for audio DSP code
CONFIG_COMPILER_OPT="-fstrict-overflow"

CONFIG_SCHED_DEADLINE=y
CONFIG_SCHED_CPU_MASK=y

# Fix the sys ticks value  until following bugs are solved:
# - https://github.com/zephyrproject-rtos/zephyr/issues/46378
CONFIG_SYS_CLOCK_TICKS_PER_SEC=15000
CONFIG_DAI=y
CONFIG_HEAP_MEM_POOL_SIZE=2048
CONFIG_CPP=y
CONFIG_STD_CPP17=y
CONFIG_STACK_SIZE_EDF=32768
CONFIG_SOF_STAGING=y
CONFIG_COMP_MFCC=y
CONFIG_COMP_TENSORFLOW=y
```

## hifi_none_overlay.conf
```kconfig
# Force generic (non-HiFi intrinsics) audio processing paths for artifact triage.
CONFIG_FILTER_HIFI_NONE=y
CONFIG_VOLUME_HIFI_NONE=y
CONFIG_COMP_STFT_PROCESS_HIFI_NONE=y
CONFIG_MIXIN_MIXOUT_HIFI_NONE=y
CONFIG_DCBLOCK_HIFI_NONE=y
CONFIG_ASRC_HIFI_NONE=y
CONFIG_COPIER_HIFI_NONE=y
CONFIG_DRC_HIFI_NONE=y
CONFIG_ARIA_HIFI_NONE=y
CONFIG_COMP_HIFI_INTRIN_TEST=n
CONFIG_COMPILER_CODEGEN_VLIW_DISABLED=y
CONFIG_XTENSA_HIFI3=n
CONFIG_XTENSA_HIFI4=n
CONFIG_XTENSA_HIFI_SHARING=n

# Keep format conversion on generic path too.
CONFIG_FORMAT_CONVERT_HIFI3=n
CONFIG_PCM_CONVERTER_FORMAT_CONVERT_HIFI3=n
```

## shell_overlay.conf
```kconfig
CONFIG_SHELL=y
CONFIG_SHELL_HELP=y
CONFIG_SHELL_CMDS=y
CONFIG_SHELL_LOG_BACKEND=y
CONFIG_SHELL_AUTOSTART=y

CONFIG_SHELL_BACKEND_ADSP_MEMORY_WINDOW=y

# mtrace uses the same window2.1 slot, so needs to be disabled
CONFIG_LOG_BACKEND_ADSP_MTRACE=n

# as mtrace is disable, enable logging via winstream/window3
CONFIG_LOG_BACKEND_ADSP=y
CONFIG_WINSTREAM_CONSOLE=y

# The SOF telemetry performance measurements use
# the same window 3 as winstream ADSP log backend, so
# these must be disabled in order to use the console.
CONFIG_SOF_TELEMETRY_PERFORMANCE_MEASUREMENTS=n
CONFIG_SOF_TELEMETRY_IO_PERFORMANCE_MEASUREMENTS=n
CONFIG_SOF_SHELL_LLEXT_LOAD=y
CONFIG_SOF_SHELL_LLEXT_LIST=y
CONFIG_SOF_SHELL_LLEXT_PURGE=y
CONFIG_SOF_SHELL_CORE_POWER=y

# Disable REBOOT since qemu_xtensa does not implement sys_arch_reboot
CONFIG_REBOOT=n

# Increase log buffer so test printk output is not dropped.
CONFIG_LOG_BUFFER_SIZE=16384

# Increase console window so all test output survives in the shared memory ring.
CONFIG_MEMORY_WIN_3_SIZE=32768
```

## wov-llext.conf
```kconfig
# Wake-on-Voice modules as LLEXT loadable modules on Intel ACE 3.0
# (PTL/WCL). The board configurations build these platforms statically,
# this overlay brings back the library manager and LLEXT, without
# userspace, and builds the WoV modules as loadable modules.
# Use together with llext_relocatable.conf.

# SOF / loadable modules
CONFIG_LIBRARY_MANAGER=y
CONFIG_LIBRARY_AUTH_SUPPORT=y
CONFIG_LIBRARY_BASE_ADDRESS=0xa0688000
# microWakeWord alone needs about 0.9 MB of the module region
CONFIG_LIBRARY_REGION_SIZE=0x180000
CONFIG_LIBRARY_BUILD_LIB=y

# Zephyr / LLEXT
CONFIG_LLEXT=y
CONFIG_LLEXT_STORAGE_WRITABLE=y
CONFIG_LLEXT_EXPERIMENTAL=y
CONFIG_LLEXT_EDK=n
CONFIG_MODULES=y
CONFIG_XTENSA_MMU_NUM_L2_TABLES=128

# WoV modules
CONFIG_COMP_MIXIN_MIXOUT=m
CONFIG_COMP_ECNS=m
CONFIG_COMP_KPB=m
CONFIG_COMP_MFCC=m
CONFIG_COMP_MWW=m
CONFIG_COMP_WOV_ARBITER=m
```

## ztest_overlay.conf
```kconfig
CONFIG_ZTEST=y
CONFIG_SOF_BOOT_TEST_STANDALONE=y
CONFIG_LOG_BACKEND_ADSP_MTRACE=y
CONFIG_ZTEST_STACK_SIZE=4096
CONFIG_MAIN_STACK_SIZE=4096
CONFIG_ISR_STACK_SIZE=4096
CONFIG_HEAP_MEM_POOL_SIZE=32768
CONFIG_LOG_MODE_IMMEDIATE=y
CONFIG_ZTEST_THREAD_PRIORITY=0
CONFIG_MAIN_THREAD_PRIORITY=0
CONFIG_ZTEST_TEST_DELAY_MS=0
CONFIG_USERSPACE=n
CONFIG_LIBRARY_DEFAULT_MODULAR=n
CONFIG_COMP_TDFB=n
CONFIG_MY_TEST_SYMBOL=y
CONFIG_MATH_IIR_DF1=y
CONFIG_SQRT_FIXED=y
CONFIG_INTEL_MODULES=n
CONFIG_LIBRARY_MANAGER=n
CONFIG_LIBRARY_AUTH_SUPPORT=n
CONFIG_LLEXT=n
CONFIG_LLEXT_STORAGE_WRITABLE=n
CONFIG_LLEXT_EXPERIMENTAL=n
CONFIG_LLEXT_TYPE_ELF_RELOCATABLE=n
CONFIG_USERSPACE=n
CONFIG_SOF_USERSPACE_LL=n
CONFIG_SOF_USERSPACE_PROXY=n
CONFIG_DYNAMIC_THREAD=n
CONFIG_DYNAMIC_THREAD_ALLOC=n
CONFIG_COMP_RTNR_STUB=y
CONFIG_CORDIC_FIXED=y

# Audio Components for ZTests
CONFIG_COMP_LEVEL_MULTIPLIER=y
CONFIG_COMP_SRC=y
CONFIG_COMP_ASRC=y
CONFIG_COMP_TONE=y
CONFIG_COMP_MIXIN_MIXOUT=y
CONFIG_COMP_ARIA=y
CONFIG_COMP_MFCC=y
CONFIG_COMP_CROSSOVER=y
CONFIG_COMP_DCBLOCK=y
CONFIG_COMP_IIR=y
CONFIG_COMP_DRC=y
CONFIG_COMP_MULTIBAND_DRC=y
CONFIG_COMP_RTNR=n
CONFIG_COMP_SMART_AMP=n
CONFIG_COMP_TDFB=y
CONFIG_COMP_GOOGLE_RTC_AUDIO_PROCESSING=n
CONFIG_COMP_GOOGLE_CTC_AUDIO_PROCESSING=n
CONFIG_COMP_IGO_NR=n
CONFIG_COMP_NXP_EAP=n
CONFIG_COMP_TENSORFLOW=n
CONFIG_COMP_SOUND_DOSE=y
CONFIG_COMP_COPIER=y
# CONFIG_DTS_CODEC is not set
CONFIG_COMP_UP_DOWN_MIXER=y
CONFIG_COMP_STFT_PROCESS=y
CONFIG_COMP_VOLUME=y
CONFIG_MINIMAL_LIBC=n
CONFIG_PICOLIBC=y
CONFIG_PICOLIBC_IO_FLOAT=y
CONFIG_CBPRINTF_FP_SUPPORT=y
CONFIG_COMP_FIR=y

# Math ZTests
CONFIG_SOF_MATH_ZTEST=y
CONFIG_COMP_TDFB_ZTEST=y
CONFIG_RUST_HELLO_ZTEST=y
CONFIG_RUST_TEMPLATE_ZTEST=y
CONFIG_INTEL_ADSP_MIC_PRIVACY=n
```

## boards/esp32p4_function_ev_board_esp32p4_hpcore.conf
```kconfig
# Target Platform & SOF Core
CONFIG_PLATFORM_ESP32P4=y
CONFIG_SOF_FULL_ZEPHYR_APPLICATION=y
CONFIG_ZEPHYR_NATIVE_DRIVERS=y
CONFIG_SYS_HEAP_BIG_ONLY=y
CONFIG_BUILD_OUTPUT_BIN=y

# Zephyr DAI Drivers for ESP32
CONFIG_DAI=y
CONFIG_DAI_ESPRESSIF_I2S=y
CONFIG_DAI_ESPRESSIF_PDM=y
CONFIG_PINCTRL=y
CONFIG_DMA=y

# Audio Processing Modules
CONFIG_COMP_VOLUME=y
CONFIG_COMP_IIR=y
CONFIG_COMP_FIR=y
CONFIG_COMP_DRC=y
CONFIG_COMP_TDFB=y
CONFIG_COMP_USB_AUDIO=y
CONFIG_FILTER_RISCV_SIMD=y
CONFIG_DRC_RISCV_SIMD=y
CONFIG_EQ_IIR_RISCV_SIMD=y
CONFIG_VOLUME_RISCV_SIMD=y

# USB Device Stack Next & UAC2 Class
CONFIG_USB_DEVICE_STACK_NEXT=y
CONFIG_CDC_ACM_SERIAL_INITIALIZE_AT_BOOT=n
CONFIG_USBD_AUDIO2_CLASS=y
CONFIG_UDC_ENABLE_SOF=y
CONFIG_UDC_DWC2_DMA=n
CONFIG_UDC_DWC2_PTI=y
CONFIG_UDC_BUF_COUNT=64
CONFIG_UDC_BUF_POOL_SIZE=16384

# USB Device Identification
CONFIG_SAMPLE_USBD_VID=0x303A
CONFIG_SAMPLE_USBD_PID=0x4002
CONFIG_SAMPLE_USBD_MANUFACTURER="Espressif"
CONFIG_SAMPLE_USBD_PRODUCT="ESP32-P4 Dual UAC2 Audio"

# System Resources & Memory
CONFIG_MAIN_STACK_SIZE=4096
CONFIG_SYSTEM_WORKQUEUE_STACK_SIZE=4096
CONFIG_USBD_THREAD_STACK_SIZE=4096
CONFIG_UDC_DWC2_STACK_SIZE=4096
CONFIG_UDC_WORKQUEUE_STACK_SIZE=4096
CONFIG_ISR_STACK_SIZE=4096
CONFIG_HW_STACK_PROTECTION=n
CONFIG_HEAP_MEM_POOL_SIZE=16384
CONFIG_TICKLESS_KERNEL=n
CONFIG_SYS_CLOCK_TICKS_PER_SEC=1000

# Logging & UART Console
CONFIG_LOG=y
CONFIG_LOG_DEFAULT_LEVEL=3
CONFIG_LOG_MAX_LEVEL=4
CONFIG_SOF_LOG_LEVEL_INF=y
CONFIG_DAI_LOG_LEVEL_INF=y
CONFIG_USBD_UAC2_LOG_LEVEL_INF=y
CONFIG_UDC_DRIVER_LOG_LEVEL_INF=y
CONFIG_LOG_MODE_DEFERRED=y
CONFIG_LOG_BUFFER_SIZE=4096
CONFIG_LOG_MODE_OVERFLOW=y
CONFIG_SHELL_LOG_BACKEND=y
CONFIG_PRINTK=y
CONFIG_EARLY_CONSOLE=y

# Interactive Shell
CONFIG_SHELL=y
CONFIG_SHELL_BACKENDS=y
CONFIG_SHELL_BACKEND_SERIAL=y
CONFIG_SHELL_PROMPT_UART="sof:~$ "

# SOF Low Latency Scheduler Statistics Logging (Every 1s)
CONFIG_SCHEDULE_LL_STATS_LOG=y
CONFIG_SCHEDULE_LL_STATS_LOG_EVERY_OTHER_WINDOW=n
CONFIG_SCHEDULE_LL_STATS_LOG_WINDOW_SIZE=10
```

## boards/intel_adsp_ace15_mtpm.conf
```kconfig
CONFIG_METEORLAKE=y
CONFIG_RIMAGE_SIGNING_SCHEMA="mtl"

# SOF / IPC configuration
CONFIG_IPC_MAJOR_4=y

# SOF / audio pipeline and module settings
CONFIG_COMP_ARIA=y
CONFIG_COMP_CROSSOVER=y
CONFIG_COMP_DRC=y
CONFIG_COMP_TESTER=m
CONFIG_COMP_SRC_IPC4_FULL_MATRIX=y
CONFIG_COMP_SRC_LITE=y
CONFIG_COMP_MFCC=y
CONFIG_COMP_MULTIBAND_DRC=y
CONFIG_FORMAT_CONVERT_HIFI3=n
CONFIG_SAMPLE_KEYPHRASE=y
CONFIG_COMP_PHASE_VOCODER=y
CONFIG_COMP_STFT_PROCESS=y
CONFIG_SOF_STAGING=y
CONFIG_CPP=y
CONFIG_STD_CPP17=y
CONFIG_COMP_TENSORFLOW=y
CONFIG_STACK_SIZE_EDF=32768





# SOF / audio modules / mocks
# This mock is part of official sof-bin releases because the CI that
# tests it can't use extra CONFIGs. See #9410, #8722 and #9386
CONFIG_COMP_GOOGLE_RTC_AUDIO_PROCESSING=m
CONFIG_GOOGLE_RTC_AUDIO_PROCESSING_MOCK=y

# SOF / infrastructure
CONFIG_AMS=y
CONFIG_COUNTER=y
CONFIG_KCPS_DYNAMIC_CLOCK_CONTROL=y
CONFIG_LL_WATCHDOG=y
CONFIG_PROBE=y
CONFIG_PROBE_DMA_MAX=2
CONFIG_SOF_TELEMETRY=y
CONFIG_SOF_TELEMETRY_IO_PERFORMANCE_MEASUREMENTS=y
CONFIG_SOF_TELEMETRY_PERFORMANCE_MEASUREMENTS=y
CONFIG_ZEPHYR_TWB_SCHEDULER=y
CONFIG_COLD_STORE_EXECUTE_DRAM=y
CONFIG_SOF_BOOT_TEST_SUPPORTED=n

# SOF / loadable modules
CONFIG_INTEL_MODULES=y
CONFIG_LIBRARY_MANAGER=y
CONFIG_LIBRARY_AUTH_SUPPORT=n

CONFIG_LIBRARY_BASE_ADDRESS=0xa0688000
CONFIG_LIBRARY_BUILD_LIB=y

# SOF / logging
CONFIG_SOF_LOG_LEVEL_INF=y

# Zephyr / OS features
CONFIG_DEBUG_COREDUMP=y
CONFIG_DEBUG_COREDUMP_BACKEND_INTEL_ADSP_MEM_WINDOW=y
CONFIG_DEBUG_COREDUMP_MEMORY_DUMP_MIN=y
CONFIG_HEAP_MEM_POOL_SIZE=8192
CONFIG_LLEXT=y
CONFIG_LLEXT_STORAGE_WRITABLE=y
CONFIG_LLEXT_EXPERIMENTAL=y
CONFIG_LLEXT_TYPE_ELF_SHAREDLIB=y
CONFIG_LLEXT_EDK=n


CONFIG_MODULES=y
CONFIG_TIMING_FUNCTIONS=y
CONFIG_WATCHDOG=y
CONFIG_TIMESLICE_PER_THREAD=y
CONFIG_THREAD_RUNTIME_STATS=y
CONFIG_SCHED_THREAD_USAGE=y

# Zephyr / device drivers
CONFIG_DAI_DMIC_HAS_OWNERSHIP=y
CONFIG_DAI_DMIC_HAS_MULTIPLE_LINE_SYNC=y
CONFIG_DAI_DMIC_HW_IOCLK=38400000
CONFIG_DAI_INIT_PRIORITY=70
CONFIG_DMA_DW_LLI_POOL_SIZE=50
CONFIG_DMA_INTEL_ADSP_GPDMA=y
CONFIG_MEMORY_WIN_2_SIZE=12288
CONFIG_MM_DRV_INTEL_ADSP_TLB_REMAP_UNUSED_RAM=y
CONFIG_MM_DRV_INTEL_VIRTUAL_REGION_COUNT=3
CONFIG_SYS_CLOCK_HW_CYCLES_PER_SEC=38400000
CONFIG_SYS_CLOCK_TICKS_PER_SEC=12000

# Zephyr / power settings
CONFIG_ADSP_IDLE_CLOCK_GATING=y
CONFIG_ADSP_IMR_CONTEXT_SAVE=n
CONFIG_PM_PREWAKEUP_CONV_MODE_CEIL=y
CONFIG_PM_DEVICE_RUNTIME_ASYNC=n

# Zephyr / logging
CONFIG_LOG_BACKEND_ADSP=n
CONFIG_LOG_BACKEND_ADSP_MTRACE=n
CONFIG_LOG_BACKEND_SOF_PROBE=y
CONFIG_LOG_BACKEND_SOF_PROBE_OUTPUT_AUTO_ENABLE=y
CONFIG_LOG_BACKEND_SOF_PROBE_BOOT_HOOK_INIT=y
CONFIG_WINSTREAM_CONSOLE=n
CONFIG_LOG_FLUSH_SLEEP_US=5000

# --- Shell over probe DMA ---
CONFIG_SHELL=y
CONFIG_SHELL_HELP=y
CONFIG_SHELL_CMDS=y
CONFIG_SHELL_AUTOSTART=y
CONFIG_SHELL_BACKEND_ADSP_MEMORY_WINDOW=y
CONFIG_SOF_SHELL_CORE_POWER=y
CONFIG_SHELL_LOG_BACKEND=y
# mtrace conflicts with shell backend for WIN2 slot 0
CONFIG_LOG_BACKEND_ADSP_MTRACE=n
CONFIG_SOF_TELEMETRY_PERFORMANCE_MEASUREMENTS=n
CONFIG_SOF_TELEMETRY_IO_PERFORMANCE_MEASUREMENTS=n
```

## src/main.c
```c
/*
 * Copyright (c) 2020 Intel Corporation.
 *
 * SPDX-License-Identifier: Apache-2.0
 */

#include <zephyr/kernel.h>
#include <sof/boot_test.h>
#include <zephyr/logging/log.h>

#if defined(CONFIG_PLATFORM_ESP32P4) || defined(CONFIG_PLATFORM_TEENSY41) || defined(CONFIG_PLATFORM_RP2350)
#include <zephyr/usb/usbd.h>
#include <zephyr/usb/class/usbd_uac2.h>
#include <zephyr/device.h>
#include <sample_usbd.h>
#include <rtos/sof.h>
#include <sof/init.h>
#include <sof/audio/pipeline/sof_static_pipeline.h>
#if defined(CONFIG_COMP_BT_AUDIO)
#include <sof/audio/bt_service.h>
#endif
#include <zephyr/drivers/gpio.h>
#endif

#if DT_NODE_EXISTS(DT_ALIAS(led0))
static const struct gpio_dt_spec s_led0 = GPIO_DT_SPEC_GET(DT_ALIAS(led0), gpios);
#endif

LOG_MODULE_REGISTER(main, LOG_LEVEL_DBG);

uint32_t g_diag_debug[8] = {0};

/* define qemu boot tests if any qemu target is defined, add targets to end */
#if defined(CONFIG_BOARD_QEMU_XTENSA_DC233C) ||\
    defined(CONFIG_BOARD_QEMU_XTENSA_DC233C_MMU)
#define QEMU_BOOT_TESTS
#endif

/**
 * Should be included from sof/schedule/task.h
 * but triggers include chain issue
 * FIXME
 */
int sof_main(int argc, char *argv[]);

/**
 * TODO: Here comes SOF initialization
 */

static int sof_app_main(void)
{
	int ret;

#if DT_NODE_EXISTS(DT_ALIAS(led0))
	if (s_led0.port && device_is_ready(s_led0.port)) {
		gpio_pin_configure_dt(&s_led0, GPIO_OUTPUT_ACTIVE);
	}
#endif

	LOG_INF("SOF on %s", CONFIG_BOARD);

	/* sof_main is actually SOF initialization */
	ret = sof_main(0, NULL);
	if (ret) {
		LOG_ERR("SOF initialization failed");
	}

	LOG_INF("SOF initialized");

#if defined(CONFIG_PLATFORM_ESP32P4) || defined(CONFIG_PLATFORM_TEENSY41) || defined(CONFIG_PLATFORM_RP2350)
	/* Initialize static audio pipelines (EQ+DRC Playback & EQ Capture) */
	sof_static_pipelines_init(sof_get());

	/* Register UAC2 class callbacks before initializing USB stack */
	const struct device *uac2_dev = DEVICE_DT_GET_ONE(zephyr_uac2);
	if (device_is_ready(uac2_dev)) {
		usbd_uac2_set_ops(uac2_dev, sof_get_uac2_ops(), NULL);
	} else {
		LOG_ERR("UAC2 device not ready");
	}

	/* Initialize USB device stack and UAC2 class */
	struct usbd_context *sample_usbd = sample_usbd_init_device(NULL);
	if (sample_usbd) {
		usbd_enable(sample_usbd);
		LOG_INF("SOF USB UAC2 device and static pipelines started");
	} else {
		LOG_ERR("Failed to initialize USB device context");
	}

#if defined(CONFIG_COMP_BT_AUDIO)
	/* Initialize Bluetooth Audio Service and power on ESP32-C6 coprocessor */
	bt_service_init();
#endif
#endif

#ifdef CONFIG_ARCH_POSIX_LIBFUZZER
	/* Workaround for an apparent timing bug in libfuzzer+asan.
	 * If the initial/main thread is allowed to return, ASAN will
	 * fairly reliably report a "stack overflow" where the ESP and
	 * EPC (instruction pointer!) registers are both set to the
	 * same value, which is non-sensical.  See some discussion in
	 * https://github.com/zephyrproject-rtos/zephyr/pull/52769
	 *
	 * But suspending the main thread instead of aborting is cheap
	 * and easy.
	 */
	k_thread_suspend(k_current_get());
#endif
	return 0;
}

#if defined(QEMU_BOOT_TESTS)
/* cleanly exit qemu so CI can continue and check test results */
static inline void qemu_xtensa_exit(int status)
{
	register int syscall_id __asm__ ("a2") = 1;      /* SYS_exit is 1 */
	register int exit_status __asm__ ("a3") = status;

	__asm__ __volatile__ (
		"simcall\n"
		:
		: "r" (syscall_id), "r" (exit_status)
		: "memory"
	);
}
#endif

#ifdef CONFIG_REBOOT
void sys_arch_reboot(int type)
{
#if defined(QEMU_BOOT_TESTS)
	qemu_xtensa_exit(type);
#endif
	while (1) {
		k_cpu_idle();
	}
}
#endif

#if CONFIG_ZTEST
void test_main(void)
{
	sof_app_main();
#if CONFIG_SOF_BOOT_TEST && (defined(QEMU_BOOT_TESTS) || CONFIG_SOF_BOOT_TEST_STANDALONE)
	sof_run_boot_tests();
#if defined(QEMU_BOOT_TESTS)
	/* qemu_xtensa_exit() only exists for QEMU targets; a standalone
	 * boot test (e.g. native_sim) just returns from test_main()
	 */
	qemu_xtensa_exit(0);
#endif
#endif
}
#else
int main(int argc, char *argv[])
{
	return sof_app_main();
}
#endif
```

## src/usbd_init.c
```c
/*
 * Copyright (c) 2026
 * SPDX-License-Identifier: Apache-2.0
 */

#include <stdint.h>
#include <string.h>
#include <stdio.h>

#include <zephyr/device.h>
#include <zephyr/usb/usbd.h>
#include <zephyr/usb/bos.h>
#include <zephyr/logging/log.h>
#include <sample_usbd.h>

LOG_MODULE_REGISTER(usbd_sample_config, LOG_LEVEL_INF);

/* By default, do not register the USB DFU class DFU mode instance. */
static const char *const blocklist[] = {
	"dfu_dfu",
	NULL,
};

/*
 * Instantiate a context named sample_usbd using the default USB device
 * controller, the Zephyr project vendor ID, and the sample product ID.
 */
USBD_DEVICE_DEFINE(sample_usbd,
		   DEVICE_DT_GET(DT_NODELABEL(zephyr_udc0)),
		   CONFIG_SAMPLE_USBD_VID, CONFIG_SAMPLE_USBD_PID);

USBD_DESC_LANG_DEFINE(sample_lang);
USBD_DESC_MANUFACTURER_DEFINE(sample_mfr, CONFIG_SAMPLE_USBD_MANUFACTURER);

#if defined(CONFIG_PLATFORM_TEENSY41)
#if defined(CONFIG_TEENSY41_BOARD_B)
USBD_DESC_PRODUCT_DEFINE(teensyb_product, "SOF Teensy 4.1 Audio B");
#elif defined(CONFIG_TEENSY41_BOARD_A)
USBD_DESC_PRODUCT_DEFINE(teensya_product, "SOF Teensy 4.1 Audio A");
#else
USBD_DESC_PRODUCT_DEFINE(default_product, "SOF Teensy 4.1 Audio");
#endif
#elif defined(CONFIG_PLATFORM_RP2350)
#if defined(CONFIG_RP2350_BOARD_B)
USBD_DESC_PRODUCT_DEFINE(rp2350b_product, "SOF RP2350 Audio B");
#elif defined(CONFIG_RP2350_BOARD_A)
USBD_DESC_PRODUCT_DEFINE(rp2350a_product, "SOF RP2350 Audio A");
#else
USBD_DESC_PRODUCT_DEFINE(default_product, "SOF RP2350 Audio");
#endif
#else
USBD_DESC_PRODUCT_DEFINE(spider_product, "SOF ESP32P4 USB Spider");
USBD_DESC_PRODUCT_DEFINE(aphid_product, "SOF ESP32P4 USB Aphid");
USBD_DESC_PRODUCT_DEFINE(pallas_product, "SOF ESP32P4 USB Pallas");
USBD_DESC_PRODUCT_DEFINE(ceres_product, "SOF ESP32P4 USB Ceres");
USBD_DESC_PRODUCT_DEFINE(default_product, "SOF ESP32P4 USB");
#endif

USBD_DESC_STRING_DEFINE(clock_master_str, "Clock Master", USBD_DUT_STRING_INTERFACE);

IF_ENABLED(CONFIG_HWINFO, (USBD_DESC_SERIAL_NUMBER_DEFINE(sample_sn)));

USBD_DESC_CONFIG_DEFINE(fs_cfg_desc, "FS Configuration");
USBD_DESC_CONFIG_DEFINE(hs_cfg_desc, "HS Configuration");

static const uint8_t attributes = (IS_ENABLED(CONFIG_SAMPLE_USBD_SELF_POWERED) ?
				   USB_SCD_SELF_POWERED : 0) |
				  (IS_ENABLED(CONFIG_SAMPLE_USBD_REMOTE_WAKEUP) ?
				   USB_SCD_REMOTE_WAKEUP : 0);

USBD_CONFIGURATION_DEFINE(sample_fs_config,
			  attributes,
			  CONFIG_SAMPLE_USBD_MAX_POWER, &fs_cfg_desc);

USBD_CONFIGURATION_DEFINE(sample_hs_config,
			  attributes,
			  CONFIG_SAMPLE_USBD_MAX_POWER, &hs_cfg_desc);

enum usbd_speed sample_usbd_get_speed(void)
{
	return usbd_bus_speed(&sample_usbd);
}

#if defined(CONFIG_PLATFORM_TEENSY41)
#include <fsl_common.h>
#include <fsl_sai.h>
#include <fsl_edma.h>
#include <sof/audio/pipeline/static_pipeline.h>
#include <sof/audio/component.h>
#include <sof/audio/pipeline.h>
#include <sof/lib/dai-zephyr.h>

extern uint32_t g_rx_pkt_cnt;
extern uint32_t g_tx_pkt_cnt;
extern struct pipeline *sof_static_pipeline_get(uint32_t pipeline_id);
extern struct comp_dev *sof_static_comp_get(uint32_t comp_id);

struct teensy_diag_data {
	uint32_t tcsr;
	uint32_t rcsr;
	uint32_t tcr2;
	uint32_t rcr2;
	uint32_t tcr3;
	uint32_t rcr3;
	uint32_t tfr0;
	uint32_t rfr0;
	uint32_t rx_pkt_cnt;
	uint32_t tx_pkt_cnt;
	uint32_t pipe1_status;
	uint32_t pipe2_status;
	uint32_t dai5_state;
	uint32_t dai6_state;
	uint32_t dma_tx_csr;
	uint32_t dma_rx_csr;
	uint32_t dma_tx_saddr;
	uint32_t dma_rx_daddr;
	uint32_t dma_tx_citer;
	uint32_t dma_rx_citer;
	uint32_t c1_state;
	uint32_t c2_state;
	uint32_t c9_state;
	uint32_t c10_state;
	uint32_t tcr4;
	uint32_t rcr4;
	uint32_t tcr5;
	uint32_t rcr5;
	uint32_t pin8_mux;
	uint32_t pin8_daisy;
	uint32_t pin7_mux;
	uint32_t pin8_pad;
	uint32_t pin7_pad;
	uint32_t gpio1_psr;
	uint32_t gpio2_psr;
	uint32_t interface_type; /* 1 = SAI1 I2S, 2 = S/PDIF */
	uint32_t g_dbg[8];
};

#define TEENSY_INTERFACE_SAI1_I2S 1
#define TEENSY_INTERFACE_SPDIF    2

extern uint32_t g_diag_debug[8];

static struct net_buf *teensy_diag_to_host(const struct usbd_context *const ctx,
					   const struct usb_setup_packet *const setup)
{
	struct net_buf *buf;
	struct teensy_diag_data diag;
	uint16_t len;

	memset(&diag, 0, sizeof(diag));
#if defined(CONFIG_TEENSY41_INTERFACE_SPDIF)
	diag.interface_type = TEENSY_INTERFACE_SPDIF;
	diag.tcsr = SPDIF->SCR;
	diag.rcsr = SPDIF->SRPC;
	diag.tcr2 = SPDIF->STC;
	diag.rcr2 = SPDIF->SRFM;
	diag.tcr3 = SPDIF->SIS;
	diag.rcr3 = SPDIF->SIE;
	diag.tfr0 = 0;
	diag.rfr0 = 0;
	diag.dma_tx_csr = DMA0->TCD[2].CSR;
	diag.dma_rx_csr = DMA0->TCD[3].CSR;
	diag.dma_tx_saddr = DMA0->TCD[2].SADDR;
	diag.dma_rx_daddr = DMA0->TCD[3].DADDR;
	diag.dma_tx_citer = DMA0->TCD[2].CITER_ELINKNO;
	diag.dma_rx_citer = DMA0->TCD[3].CITER_ELINKNO;
#else
	diag.interface_type = TEENSY_INTERFACE_SAI1_I2S;
	diag.tcsr = SAI1->TCSR;
	diag.rcsr = SAI1->RCSR;
	diag.tcr2 = SAI1->TCR2;
	diag.rcr2 = SAI1->RCR2;
	diag.tcr3 = SAI1->TCR3;
	diag.rcr3 = SAI1->RCR3;
	diag.tfr0 = (SAI1->TCR3 & I2S_TCR3_TCE(4)) ? SAI1->TFR[2] : SAI1->TFR[0];
	diag.rfr0 = SAI1->RFR[0];
	diag.dma_tx_csr = DMA0->TCD[0].CSR;
	diag.dma_rx_csr = DMA0->TCD[1].CSR;
	diag.dma_tx_saddr = DMA0->TCD[0].SADDR;
	diag.dma_rx_daddr = DMA0->TCD[1].DADDR;
	diag.dma_tx_citer = DMA0->TCD[0].CITER_ELINKNO;
	diag.dma_rx_citer = DMA0->TCD[1].CITER_ELINKNO;
#endif

	diag.rx_pkt_cnt = g_rx_pkt_cnt;
	diag.tx_pkt_cnt = g_tx_pkt_cnt;

	struct pipeline *p1 = sof_static_pipeline_get(1);
	struct pipeline *p2 = sof_static_pipeline_get(2);
	if (p1) diag.pipe1_status = p1->status;
	if (p2) diag.pipe2_status = p2->status;

	struct comp_dev *c1 = sof_static_comp_get(1);
	struct comp_dev *c2 = sof_static_comp_get(2);
	struct comp_dev *c5 = sof_static_comp_get(5);
	struct comp_dev *c6 = sof_static_comp_get(6);
	struct comp_dev *c9 = sof_static_comp_get(9);
	struct comp_dev *c10 = sof_static_comp_get(10);
	if (c1) diag.c1_state = c1->state;
	if (c2) diag.c2_state = c2->state;
	if (c5) diag.dai5_state = c5->state;
	if (c6) diag.dai6_state = c6->state;
	if (c9) diag.c9_state = c9->state;
	if (c10) diag.c10_state = c10->state;

	diag.tcr4 = SAI1->TCR4;
	diag.rcr4 = SAI1->RCR4;
	diag.tcr5 = SAI1->TCR5;
	diag.rcr5 = SAI1->RCR5;
	diag.pin8_mux = *(volatile uint32_t *)0x401F817C;
	diag.pin8_daisy = *(volatile uint32_t *)0x401F8594;
	diag.pin7_mux = *(volatile uint32_t *)0x401F8180;
	diag.pin8_pad = *(volatile uint32_t *)0x401F836C;
	diag.pin7_pad = *(volatile uint32_t *)0x401F8370;
	diag.gpio1_psr = *(volatile uint32_t *)0x401B8008;
	diag.gpio2_psr = *(volatile uint32_t *)0x401BC008;
	memcpy(diag.g_dbg, g_diag_debug, sizeof(diag.g_dbg));

	len = MIN(setup->wLength, sizeof(diag));
	buf = usbd_ep_ctrl_data_in_alloc(ctx, len);
	if (!buf) return NULL;
	net_buf_add_mem(buf, &diag, len);
	return buf;
}

static int teensy_reboot_to_dev(const struct usbd_context *const ctx,
				const struct usb_setup_packet *const setup,
				const struct net_buf *const buf)
{
	ARG_UNUSED(ctx);
	ARG_UNUSED(setup);
	ARG_UNUSED(buf);
	__asm__ volatile("bkpt #251");
	return 0;
}

static struct net_buf *teensy_peek_to_host(const struct usbd_context *const ctx,
					   const struct usb_setup_packet *const setup)
{
	uint32_t addr = (setup->wIndex << 16) | setup->wValue;
	uint16_t len = MIN(setup->wLength, 64);
	if (!len) return NULL;
	struct net_buf *buf = usbd_ep_ctrl_data_in_alloc(ctx, len);
	if (!buf) return NULL;
	net_buf_add_mem(buf, (const void *)addr, len);
	return buf;
}

static int teensy_poke_to_dev(const struct usbd_context *const ctx,
			      const struct usb_setup_packet *const setup,
			      const struct net_buf *const buf)
{
	ARG_UNUSED(ctx);
	uint32_t addr = (setup->wIndex << 16) | setup->wValue;
	if (buf && buf->len > 0) {
		if (setup->wLength == 1) {
			*(volatile uint8_t *)addr = buf->data[0];
		} else if (setup->wLength == 2) {
			uint16_t val;
			memcpy(&val, buf->data, 2);
			*(volatile uint16_t *)addr = val;
		} else if (setup->wLength == 4) {
			uint32_t val;
			memcpy(&val, buf->data, 4);
			*(volatile uint32_t *)addr = val;
		}
	}
	return 0;
}

USBD_VREQUEST_DEFINE(teensy_reboot_vreq, 0xFB, NULL, teensy_reboot_to_dev);
USBD_VREQUEST_DEFINE(teensy_diag_vreq, 0xFC, teensy_diag_to_host, NULL);
USBD_VREQUEST_DEFINE(teensy_peek_poke_vreq, 0xFD, teensy_peek_to_host, teensy_poke_to_dev);
#endif

static void sample_fix_code_triple(struct usbd_context *uds_ctx,
				   const enum usbd_speed speed)
{
	if (IS_ENABLED(CONFIG_USBD_CDC_ACM_CLASS) ||
	    IS_ENABLED(CONFIG_USBD_CDC_ECM_CLASS) ||
	    IS_ENABLED(CONFIG_USBD_CDC_NCM_CLASS) ||
	    IS_ENABLED(CONFIG_USBD_MIDI2_CLASS) ||
	    IS_ENABLED(CONFIG_USBD_AUDIO2_CLASS) ||
	    IS_ENABLED(CONFIG_USBD_VIDEO_CLASS)) {
		usbd_device_set_code_triple(uds_ctx, speed,
					    USB_BCC_MISCELLANEOUS, 0x02, 0x01);
	} else {
		usbd_device_set_code_triple(uds_ctx, speed, 0, 0, 0);
	}
}

struct usbd_context *sample_usbd_setup_device(usbd_msg_cb_t msg_cb)
{
	int err;
#if defined(CONFIG_PLATFORM_TEENSY41)
	struct usbd_desc_node *product_desc;
#if defined(CONFIG_TEENSY41_BOARD_B)
	product_desc = &teensyb_product;
	LOG_INF("Board Identity: TEENSY 4.1 BOARD B (Slave / Rx)");
#elif defined(CONFIG_TEENSY41_BOARD_A)
	product_desc = &teensya_product;
	LOG_INF("Board Identity: TEENSY 4.1 BOARD A (Master / Tx)");
#else
	product_desc = &default_product;
	LOG_INF("Board Identity: Generic Teensy 4.1 Audio");
#endif
#elif defined(CONFIG_PLATFORM_RP2350)
	struct usbd_desc_node *product_desc;
#if defined(CONFIG_RP2350_BOARD_B)
	product_desc = &rp2350b_product;
	LOG_INF("Board Identity: RP2350 BOARD B (Slave / Rx)");
#elif defined(CONFIG_RP2350_BOARD_A)
	product_desc = &rp2350a_product;
	LOG_INF("Board Identity: RP2350 BOARD A (Master / Tx)");
#else
	product_desc = &default_product;
	LOG_INF("Board Identity: Generic RP2350 Audio");
#endif
#elif defined(CONFIG_PLATFORM_ESP32P4)
	uint8_t mac[6] = {0};
	extern int esp_efuse_mac_get_default(uint8_t *mac);
	esp_efuse_mac_get_default(mac);

	printk("[USB INIT] Chip MAC: %02X:%02X:%02X:%02X:%02X:%02X\n",
	       mac[0], mac[1], mac[2], mac[3], mac[4], mac[5]);

	struct usbd_desc_node *product_desc = &default_product;
	if (mac[5] == 0xC7 || mac[5] == 0xc7) {
		LOG_INF("Board Identity: SPIDER PDM DUT (MAC %02X:%02X:%02X:%02X:%02X:%02X)",
		        mac[0], mac[1], mac[2], mac[3], mac[4], mac[5]);
		product_desc = &spider_product;
	} else if (mac[5] == 0x15) {
		LOG_INF("Board Identity: APHID I2S DUT (MAC %02X:%02X:%02X:%02X:%02X:%02X)",
		        mac[0], mac[1], mac[2], mac[3], mac[4], mac[5]);
		product_desc = &aphid_product;
	} else if (mac[5] == 0x17) {
		LOG_INF("Board Identity: PALLAS TX MASTER (MAC %02X:%02X:%02X:%02X:%02X:%02X)",
		        mac[0], mac[1], mac[2], mac[3], mac[4], mac[5]);
		product_desc = &pallas_product;
	} else if (mac[5] == 0x6C || mac[5] == 0x6c) {
		LOG_INF("Board Identity: CERES RX SLAVE (MAC %02X:%02X:%02X:%02X:%02X:%02X)",
		        mac[0], mac[1], mac[2], mac[3], mac[4], mac[5]);
		product_desc = &ceres_product;
	} else {
		LOG_INF("Board Identity: Generic ESP32-P4 (MAC %02X:%02X:%02X:%02X:%02X:%02X)",
		        mac[0], mac[1], mac[2], mac[3], mac[4], mac[5]);
		product_desc = &default_product;
	}
#else
	struct usbd_desc_node *product_desc = &default_product;
#endif

	err = usbd_add_descriptor(&sample_usbd, &sample_lang);
	if (err) {
		LOG_ERR("Failed to initialize language descriptor (%d)", err);
		return NULL;
	}

	err = usbd_add_descriptor(&sample_usbd, &sample_mfr);
	if (err) {
		LOG_ERR("Failed to initialize manufacturer descriptor (%d)", err);
		return NULL;
	}

	err = usbd_add_descriptor(&sample_usbd, product_desc);
	if (err) {
		LOG_ERR("Failed to initialize product descriptor (%d)", err);
		return NULL;
	}

	IF_ENABLED(CONFIG_HWINFO, (
		err = usbd_add_descriptor(&sample_usbd, &sample_sn);
		if (err) {
			LOG_ERR("Failed to initialize SN descriptor (%d)", err);
			return NULL;
		}
	))

	err = usbd_add_descriptor(&sample_usbd, &clock_master_str);
	if (err) {
		LOG_ERR("Failed to initialize Clock Master string descriptor (%d)", err);
		return NULL;
	}
	LOG_INF("Registered Clock Master string descriptor at index %u", clock_master_str.str.idx);

	if (USBD_SUPPORTS_HIGH_SPEED &&
	    usbd_caps_speed(&sample_usbd) == USBD_SPEED_HS) {
		err = usbd_add_configuration(&sample_usbd, USBD_SPEED_HS,
					     &sample_hs_config);
		if (err) {
			LOG_ERR("Failed to add High-Speed configuration");
			return NULL;
		}

		err = usbd_register_all_classes(&sample_usbd, USBD_SPEED_HS, 1,
						blocklist);
		if (err) {
			LOG_ERR("Failed to register classes");
			return NULL;
		}

		sample_fix_code_triple(&sample_usbd, USBD_SPEED_HS);
	}

	err = usbd_add_configuration(&sample_usbd, USBD_SPEED_FS,
				     &sample_fs_config);
	if (err) {
		LOG_ERR("Failed to add Full-Speed configuration");
		return NULL;
	}

	err = usbd_register_all_classes(&sample_usbd, USBD_SPEED_FS, 1, blocklist);
	if (err) {
		LOG_ERR("Failed to register classes");
		return NULL;
	}

	sample_fix_code_triple(&sample_usbd, USBD_SPEED_FS);
	usbd_self_powered(&sample_usbd, attributes & USB_SCD_SELF_POWERED);

	if (msg_cb != NULL) {
		err = usbd_msg_register_cb(&sample_usbd, msg_cb);
		if (err) {
			LOG_ERR("Failed to register message callback");
			return NULL;
		}
	}

#if defined(CONFIG_PLATFORM_TEENSY41)
	err = usbd_device_register_vreq(&sample_usbd, &teensy_reboot_vreq);
	if (err) {
		LOG_ERR("Failed to register vendor reboot request (%d)", err);
	}
	err = usbd_device_register_vreq(&sample_usbd, &teensy_diag_vreq);
	if (err) {
		LOG_ERR("Failed to register vendor diag request (%d)", err);
	}
	err = usbd_device_register_vreq(&sample_usbd, &teensy_peek_poke_vreq);
	if (err) {
		LOG_ERR("Failed to register vendor peek/poke request (%d)", err);
	}
#endif

	return &sample_usbd;
}

struct usbd_context *sample_usbd_init_device(usbd_msg_cb_t msg_cb)
{
	int err;

	if (sample_usbd_setup_device(msg_cb) == NULL) {
		return NULL;
	}

	err = usbd_init(&sample_usbd);
	if (err) {
		LOG_ERR("Failed to initialize device support");
		return NULL;
	}

	return &sample_usbd;
}
```
